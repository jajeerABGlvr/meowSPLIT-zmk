## boards/shields/meowsplit/Kconfig.shield
```kconfig
config SHIELD_MEOWSPLIT_LEFT
    def_bool $(shields_list_contains,meowsplit_left)

config SHIELD_MEOWSPLIT_RIGHT
    def_bool $(shields_list_contains,meowsplit_right)
```
